## meta-hpe-private/meta-2pdl/conf/layer.conf
```bitbake
# We have a conf and classes directory, add to BBPATH
BBPATH .= ":${LAYERDIR}"

# We have recipes-* directories, add to BBFILES
BBFILES += "${LAYERDIR}/recipes-*/*/*.bb \
            ${LAYERDIR}/recipes-*/*/*.bbappend"

BBFILE_COLLECTIONS += "2pdl-layer"
BBFILE_PATTERN_2pdl-layer := "^${LAYERDIR}/"
LAYERSERIES_COMPAT_2pdl-layer = "hardknott"
```

## meta-hpe-private/meta-common/conf/layer.conf
```bitbake
# We have a conf and classes directory, add to BBPATH
BBPATH .= ":${LAYERDIR}"

# We have recipes-* directories, add to BBFILES
BBFILES += "${LAYERDIR}/recipes-*/*/*.bb \
            ${LAYERDIR}/recipes-*/*/*.bbappend"

BBFILE_COLLECTIONS += "common-private-layer"
BBFILE_PATTERN_common-private-layer := "^${LAYERDIR}/"
LAYERSERIES_COMPAT_common-private-layer = "langdale mickledore"
```

## meta-hpe-private/meta-dl325/conf/layer.conf
```bitbake
# We have a conf and classes directory, add to BBPATH
BBPATH .= ":${LAYERDIR}"

# We have recipes-* directories, add to BBFILES
BBFILES += "${LAYERDIR}/recipes-*/*/*.bb \
            ${LAYERDIR}/recipes-*/*/*.bbappend"

BBFILE_COLLECTIONS += "dl325-layer"
BBFILE_PATTERN_dl325-layer := "^${LAYERDIR}/"
LAYERSERIES_COMPAT_dl325-layer = "hardknott"
```

## meta-hpe-private/meta-dl380g10p-t265/conf/layer.conf
```bitbake
# We have a conf and classes directory, add to BBPATH
BBPATH .= ":${LAYERDIR}"

# We have recipes-* directories, add to BBFILES
BBFILES += "${LAYERDIR}/recipes-*/*/*.bb \
            ${LAYERDIR}/recipes-*/*/*.bbappend"

BBFILE_COLLECTIONS += "dl380g10p-t265-layer"
BBFILE_PATTERN_dl380g10p-t265-layer := "^${LAYERDIR}/"
LAYERSERIES_COMPAT_dl380g10p-t265-layer = "hardknott"
```

## meta-hpe-private/meta-dl380g10p-t265/conf/machine/dl380g10p-t265.conf
```bitbake
KERNEL_DEVICETREE = "gxp.dtb"

require conf/machine/include/gxp.inc
require conf/machine/include/obmc-bsp-common.inc
require conf/machine/include/hpe.inc

PREFERRED_PROVIDER_virtual/phosphor-led-manager-config-native = "hpe-g10p-common-led-manager-config-native"
```

## meta-hpe-private/meta-evb-t261/conf/layer.conf
```bitbake
# We have a conf and classes directory, add to BBPATH
BBPATH .= ":${LAYERDIR}"

# We have recipes-* directories, add to BBFILES
BBFILES += "${LAYERDIR}/recipes-*/*/*.bb \
            ${LAYERDIR}/recipes-*/*/*.bbappend"

BBFILE_COLLECTIONS += "evb-t261-layer"
BBFILE_PATTERN_evb-t261-layer := "^${LAYERDIR}/"
LAYERSERIES_COMPAT_evb-t261-layer = "hardknott"
```

## meta-hpe-private/meta-gxp/conf/layer.conf
```bitbake
# We have a conf and classes directory, add to BBPATH
BBPATH .= ":${LAYERDIR}"

BBFILES += "${LAYERDIR}/recipes-*/*/*.bb \
            ${LAYERDIR}/recipes-*/*/*.bbappend"

BBFILE_COLLECTIONS += "gxp-private-layer"
BBFILE_PATTERN_gxp-private-layer = "^${LAYERDIR}/"
LAYERVERSION_gxp-private-layer = "1"
LAYERSERIES_COMPAT_gxp-private-layer = "langdale mickledore"

GXPBASE = '${@os.path.normpath("${LAYERDIR}/")}'
```

## meta-hpe-private/meta-rl300-g11/conf/machine/rl300-g11.conf
```bitbake
KERNEL_DEVICETREE = "gxp.dtb"

require conf/machine/include/gxp.inc
require conf/machine/include/obmc-bsp-common.inc
require conf/machine/include/hpe.inc

PREFERRED_PROVIDER_virtual/obmc-host-ipmi-hw = "phosphor-ipmi-ssif"
PREFERRED_PROVIDER_virtual/phosphor-led-manager-config-native = "hpe-g10p-common-led-manager-config-native"
```

## meta-hpe-private/meta-seaport/conf/layer.conf
```bitbake
# We have a conf and classes directory, add to BBPATH
BBPATH .= ":${LAYERDIR}"

# We have recipes-* directories, add to BBFILES
BBFILES += "${LAYERDIR}/recipes-*/*/*.bb \
            ${LAYERDIR}/recipes-*/*/*.bbappend"

BBFILE_COLLECTIONS += "seaport-layer"
BBFILE_PATTERN_seaport-layer := "^${LAYERDIR}/"
LAYERSERIES_COMPAT_seaport-layer = "hardknott"
```
